// ============================================================================
// Bme280Core.h — ЧИСТАЯ ЛОГИКА BME280/BMP280 (компенсация, калибровка, у.м.)
// ============================================================================
// Стадия W1 профиля weather_gate. Зависимостей от Arduino/FreeRTOS НЕТ —
// компилируется на хосте (D2: host-тесты, эталон — независимая float-
// реализация формул Bosch в tests.cpp, НЕ копия этого кода).
//
// Что здесь:
//   · карта калибровочных регистров (даташит Bosch BST-BME280-DS002, 4.2.2);
//   · целочисленная компенсация Bosch (32-бит температура, 64-бит давление,
//     32-бит влажность) — выбрана целая арифметика: на ESP32 float-версия
//     дрейфует на экстремумах ADC, а целая воспроизводима бит-в-бит и
//     проверяема host-тестами на любой платформе;
//   · приведение давления к уровню моря (стандартная барометрическая
//     формула) — нужна Замбретти (W5) и телеметрии.
//
// Чего здесь НЕТ: I2C, шин, мьютексов, конфига — это Bme280Driver.cpp.
// ============================================================================
#pragma once

#include <cstdint>
#include <cmath>

namespace bme280 {

// --- ИДЕНТИФИКАЦИЯ (регистр 0xD0) --------------------------------------------
constexpr uint8_t CHIP_ID_BMP280 = 0x58;   // давление+температура, БЕЗ влажности
constexpr uint8_t CHIP_ID_BME280 = 0x60;   // полный набор
constexpr uint8_t ADDR_LOW       = 0x76;   // SDO на GND
constexpr uint8_t ADDR_HIGH      = 0x77;   // SDO на VCC

// --- КАЛИБРОВКА (заводская, прошита в OTP датчика) ----------------------------
// Даташит 4.2.2: блок 0x88..0xA1 (26 байт, T и P + H1 в 0xA1),
// блок 0xE1..0xE7 (7 байт, H2..H6 со специфической упаковкой).
struct Calib {
    // Температура
    uint16_t t1; int16_t t2, t3;
    // Давление
    uint16_t p1; int16_t p2, p3, p4, p5, p6, p7, p8, p9;
    // Влажность (только BME280)
    uint8_t h1; int16_t h2; uint8_t h3; int16_t h4, h5; int8_t h6;
};

/// Разбор блока 0x88..0xA1 (26 байт, little-endian). Заполняет T, P и H1.
inline void parseCalibTP(const uint8_t* b, Calib& c) {
    c.t1 = (uint16_t)(b[0]  | (b[1]  << 8));
    c.t2 = (int16_t)( b[2]  | (b[3]  << 8));
    c.t3 = (int16_t)( b[4]  | (b[5]  << 8));
    c.p1 = (uint16_t)(b[6]  | (b[7]  << 8));
    c.p2 = (int16_t)( b[8]  | (b[9]  << 8));
    c.p3 = (int16_t)( b[10] | (b[11] << 8));
    c.p4 = (int16_t)( b[12] | (b[13] << 8));
    c.p5 = (int16_t)( b[14] | (b[15] << 8));
    c.p6 = (int16_t)( b[16] | (b[17] << 8));
    c.p7 = (int16_t)( b[18] | (b[19] << 8));
    c.p8 = (int16_t)( b[20] | (b[21] << 8));
    c.p9 = (int16_t)( b[22] | (b[23] << 8));
    c.h1 = b[25];                        // 0xA1
}

/// Разбор блока 0xE1..0xE7 (7 байт). H4/H5 упакованы по 12 бит через 0xE5.
inline void parseCalibH(const uint8_t* b, Calib& c) {
    c.h2 = (int16_t)(b[0] | (b[1] << 8));            // 0xE1/0xE2
    c.h3 = b[2];                                     // 0xE3
    c.h4 = (int16_t)((b[3] << 4) | (b[4] & 0x0F));   // 0xE4 + младшие 0xE5
    c.h5 = (int16_t)((b[5] << 4) | (b[4] >> 4));     // 0xE6 + старшие 0xE5
    c.h6 = (int8_t)b[6];                             // 0xE7
}

// --- КОМПЕНСАЦИЯ (целочисленные формулы Bosch, даташит 4.2.3) ----------------

/// Температура. adcT — 20-бит сырьё из 0xFA..0xFC.
/// Возврат: 0.01 °C (2508 = 25.08 °C). tFineOut — t_fine для P и H
/// (ОБЯЗАТЕЛЬНО из того же измерения — формулы давления/влажности
/// используют t_fine текущего цикла, не «свежайший»).
inline int32_t compensateTemp(int32_t adcT, const Calib& c, int32_t& tFineOut) {
    int32_t var1 = ((((adcT >> 3) - ((int32_t)c.t1 << 1))) * (int32_t)c.t2) >> 11;
    int32_t var2 = (((((adcT >> 4) - (int32_t)c.t1) * ((adcT >> 4) - (int32_t)c.t1)) >> 12)
                    * (int32_t)c.t3) >> 14;
    tFineOut = var1 + var2;
    return (tFineOut * 5 + 128) >> 8;
}

/// Давление (64-бит вариант Bosch). adcP — 20-бит сырьё из 0xF7..0xF9.
/// Возврат: Паскали в Q24.8 (значение/256 = Па). 0 — вырожденная калибровка.
inline uint32_t compensatePress(int32_t adcP, const Calib& c, int32_t tFine) {
    int64_t var1 = (int64_t)tFine - 128000;
    int64_t var2 = var1 * var1 * (int64_t)c.p6;
    var2 += (var1 * (int64_t)c.p5) << 17;
    var2 += ((int64_t)c.p4) << 35;
    var1 = ((var1 * var1 * (int64_t)c.p3) >> 8) + ((var1 * (int64_t)c.p2) << 12);
    var1 = ((((int64_t)1 << 47) + var1) * (int64_t)c.p1) >> 33;
    if (var1 == 0) return 0;             // защита от деления на ноль
    int64_t p = 1048576 - adcP;
    p = (((p << 31) - var2) * 3125) / var1;
    var1 = ((int64_t)c.p9 * (p >> 13) * (p >> 13)) >> 25;
    var2 = ((int64_t)c.p8 * p) >> 19;
    p = ((p + var1 + var2) >> 8) + (((int64_t)c.p7) << 4);
    // Край ADC (adcP -> максимум): истинное давление уходит в минус,
    // что физически невозможно (датчик насыщается у нижнего предела).
    // Без отсечки каст в uint32 заворачивает значение в ~16.7 МПа (урок
    // найден host-тестом 17.08.2026) — даталог и Замбретти съели бы мусор.
    if (p < 0) return 0;                 // 0 = «точка невалидна», как при var1==0
    return (uint32_t)p;                  // Q24.8 Па
}

/// Влажность (32-бит вариант Bosch). adcH — 16-бит сырьё из 0xFD..0xFE.
/// Возврат: %RH в Q22.10 (значение/1024 = %).
inline uint32_t compensateHum(int32_t adcH, const Calib& c, int32_t tFine) {
    int32_t v = tFine - 76800;
    v = (((((adcH << 14) - ((int32_t)c.h4 << 20) - ((int32_t)c.h5 * v)) + 16384) >> 15)
         * (((((((v * (int32_t)c.h6) >> 10)
               * (((v * (int32_t)c.h3) >> 11) + 32768)) >> 10) + 2097152)
             * (int32_t)c.h2 + 8192) >> 14));
    v = v - (((((v >> 15) * (v >> 15)) >> 7) * (int32_t)c.h1) >> 4);
    if (v < 0) v = 0;
    if (v > 419430400) v = 419430400;    // 100 % в Q22.10
    return (uint32_t)v >> 12;
}

// --- ПРИВЕДЕНИЕ К УРОВНЮ МОРЯ ------------------------------------------------
/// Стандартная барометрическая формула: p0 = p / (1 - h/44330)^5.255.
/// altitudeM — высота установки датчика (wx.altitude_m); 0 — приведение
/// отключено (возвращается станционное давление как есть).
inline float seaLevelPressureHpa(float pressHpa, float altitudeM) {
    if (altitudeM == 0.0f) return pressHpa;
    return pressHpa / powf(1.0f - altitudeM / 44330.0f, 5.255f);
}

} // namespace bme280
